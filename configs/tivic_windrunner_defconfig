## configs/tivic_windrunner_defconfig
```kconfig
BR2_arm=y
BR2_TOOLCHAIN_EXTERNAL=y
BR2_TOOLCHAIN_EXTERNAL_CODESOURCERY_ARM2009Q1=y
BR2_TARGET_GENERIC_HOSTNAME="botbot"
BR2_TARGET_GENERIC_ISSUE="Welcome to BotBot"
BR2_TARGET_GENERIC_GETTY_BAUDRATE_38400=y
BR2_PACKAGE_MTD=y
# BR2_PACKAGE_MTD_MTD_DEBUG is not set
# BR2_PACKAGE_MTD_NANDDUMP is not set
# BR2_PACKAGE_MTD_NANDTEST is not set
# BR2_PACKAGE_MTD_NANDWRITE is not set
# BR2_PACKAGE_MTD_UBIATTACH is not set
# BR2_PACKAGE_MTD_UBICRC32 is not set
# BR2_PACKAGE_MTD_UBIDETACH is not set
# BR2_PACKAGE_MTD_UBIFORMAT is not set
# BR2_PACKAGE_MTD_UBIMKVOL is not set
# BR2_PACKAGE_MTD_UBINFO is not set
# BR2_PACKAGE_MTD_UBINIZE is not set
# BR2_PACKAGE_MTD_UBIRENAME is not set
# BR2_PACKAGE_MTD_UBIRMVOL is not set
# BR2_PACKAGE_MTD_UBIRSVOL is not set
# BR2_PACKAGE_MTD_UBIUPDATEVOL is not set
BR2_PACKAGE_UBOOT_TOOLS=y
BR2_PACKAGE_USBUTILS=y
BR2_PACKAGE_USBUTILS_ZLIB=y
BR2_PACKAGE_PYTHON=y
BR2_PACKAGE_LZO=y
BR2_PACKAGE_READLINE=y
BR2_PACKAGE_DROPBEAR=y
BR2_PACKAGE_NTP=y
BR2_PACKAGE_NTP_NTPDATE=y
BR2_PACKAGE_OPENSSH=y
BR2_PACKAGE_RSYNC=y
BR2_PACKAGE_TRANSMISSION=y
BR2_PACKAGE_TRANSMISSION_UTP=y
BR2_PACKAGE_TRANSMISSION_CLI=y
BR2_PACKAGE_TRANSMISSION_DAEMON=y
BR2_PACKAGE_TRANSMISSION_REMOTE=y
BR2_PACKAGE_VSFTPD=y
BR2_PACKAGE_IPKG=y
BR2_PACKAGE_LOGROTATE=y
BR2_PACKAGE_SCREEN=y
BR2_TARGET_ROOTFS_JFFS2=y
BR2_LINUX_KERNEL=y
BR2_LINUX_KERNEL_CUSTOM_TARBALL=y
BR2_LINUX_KERNEL_CUSTOM_TARBALL_LOCATION="file://./board/tivic_windrunner/linux/linux-2.6.16-cavium.tar.bz2"
BR2_LINUX_KERNEL_PATCH="board/tivic_windrunner/linux"
BR2_LINUX_KERNEL_USE_CUSTOM_CONFIG=y
BR2_LINUX_KERNEL_CUSTOM_CONFIG_FILE="board/tivic_windrunner/linux/cns2132_kernel_config"
```

## package/botbot_features/Config.in
```kconfig
config BR2_PACKAGE_BOTBOT_FEATURES
	bool "BotBot Features"
	help
	  Add snakeos tid bits to the find file system

	  (edit package/botbot_features/botbot_features.mk)
```

## package/multimedia/minidlna/Config.in
```kconfig
config BR2_PACKAGE_MINIDLNA
	bool "minidlna"
	help
        Minidlna server
        Prerequisites :

        - libexif
        - libjpeg
        - libid3tag
        - libFLAC
        - libvorbis
        - sqlite3
        - libavformat (the ffmpeg libraries)
        - libuuid
```
